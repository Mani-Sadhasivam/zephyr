## arch/arm/soc/actions_atb110x/Kconfig.defconfig
```kconfig
# Kconfig.defconfig - Actions (Zhuhai) Technology ATB110XY
#
# Copyright (c) 2019 Actions (Zhuhai) Technology Co., Ltd
#
# SPDX-License-Identifier: Apache-2.0
#

if SOC_ACTIONS_ATB110X

config SOC
	default "actions_atb110x"

config ISR_STACK_SIZE
	default 640
	
config SYS_CLOCK_HW_CYCLES_PER_SEC
	int
	default 32000000

config SYS_POWER_MANAGEMENT
	default y

config NUM_IRQS
	int
	default 32

config BUILD_OUTPUT_HEX
	default y
endif
```

## arch/arm/soc/actions_atb110x/Kconfig.soc
```kconfig
# Kconfig -  Actions (Zhuhai) Technology ATB110XY
#
# Copyright (c) 2019 Actions (Zhuhai) Technology Co., Ltd
#
# SPDX-License-Identifier: Apache-2.0
#

config  SOC_ACTIONS_ATB110X
	bool "ACTIONS ATB110X MCU"
	select CPU_CORTEX_M
	select CPU_CORTEX_M0
	select PLATFORM_SPECIFIC_INIT
	select XIP
	select CPU_HAS_SYSTICK
	help
	  Enable support for ACTIONS_ATB110X BLE SOC
```

## boards/arm/96b_avenger96/Kconfig.defconfig
```kconfig
# Kconfig - 96Boards Avenger96 board configuration
#
# Copyright (c) 2019 Linaro Ltd.
#
# SPDX-License-Identifier: Apache-2.0
#

if BOARD_96B_AVENGER96

config BOARD
	default "96b_avenger96"

if I2C

config I2C_1
	default y

endif # I2C

if UART_CONSOLE

config UART_7
	default y

endif # UART_CONSOLE

if SERIAL

config UART_4
	default y

endif # SERIAL

endif # BOARD_96B_AVENGER96
```

## boards/arm/atb1103_dongle/Kconfig.board
```kconfig
# Kconfig - Actions (Zhuhai) Technology ATB110XY
#
# Copyright (c) 2019 Actions (Zhuhai) Technology Co., Ltd
#
# SPDX-License-Identifier: Apache-2.0

config BOARD_ATB1103_DONGLE
	bool "ATB1103 DONGLE"
	depends on SOC_ACTIONS_ATB110X
```

## boards/arm/atb1103_dongle/Kconfig.defconfig
```kconfig
# Kconfig - Actions (Zhuhai) Technology ATB110XY
#
# Copyright (c) 2019 Actions (Zhuhai) Technology Co., Ltd
#
# SPDX-License-Identifier: Apache-2.0

if BOARD_ATB1103_DONGLE

config BOARD
	default "atb1103 dongle"

endif # BOARD_ATB1103_DONGLE
```

## boards/arm/atb1103_dongle/atb1103_dongle_defconfig
```kconfig
CONFIG_ARM=y
CONFIG_SOC_ACTIONS_ATB110X=y
CONFIG_BOARD_ATB1103_DONGLE=y

CONFIG_CPU_HAS_SYSTICK=y

#
# General Kernel Options
#
CONFIG_THREAD_STACK_INFO=y
CONFIG_INIT_STACKS=y

CONFIG_SYS_POWER_MANAGEMENT=n

# enable console
CONFIG_CONSOLE=y
CONFIG_UART_CONSOLE=y

# enable uart driver
CONFIG_SERIAL=y
CONFIG_UART_INTERRUPT_DRIVEN=y
CONFIG_UART_ACTS=y

# enable gpio driver
CONFIG_GPIO=y
CONFIG_GPIO_ACTS=y
```

## boards/arm/mimx8mm6_evk/Kconfig.defconfig
```kconfig
# Kconfig - MIMX8MM6 EVK board
#
# Copyright (c) 2019, Manivannan Sadhasivam <mani@kernel.org>
#
# SPDX-License-Identifier: Apache-2.0
#

if BOARD_MIMX8MM6_EVK

config BOARD
	default "mimx8mm6_evk"

if GPIO_MCUX_IGPIO

config GPIO_MCUX_IGPIO_3
	default y

endif # GPIO_MCUX_IGPIO

if I2C_MCUX

config I2C_3
	default y

endif # I2C_MCUX

if UART_MCUX_IMX

config UART_MCUX_IMX_4
	default y

endif # UART_MCUX_IMX

if !XIP
config FLASH_SIZE
	default 0
config FLASH_BASE_ADDRESS
	default 0
endif

endif # BOARD_MIMX8MM6_EVK
```

## boards/arm/mimx8mm6_evk/mimx8mm6_evk_defconfig
```kconfig
#
# Copyright (c) 2019, Manivannan Sadhasivam <mani@kernel.org>
#
# SPDX-License-Identifier: Apache-2.0
#

CONFIG_ARM=y
CONFIG_SOC_FAMILY_IMX=y
CONFIG_SOC_SERIES_IMX8_M4=y
CONFIG_SOC_MIMX8MM6=y
CONFIG_BOARD_MIMX8MM6_EVK=y
CONFIG_CORTEX_M_SYSTICK=y
CONFIG_SERIAL_HAS_DRIVER=y
CONFIG_CLOCK_CONTROL=y
CONFIG_UART_CONSOLE=y
CONFIG_SERIAL=y
#CONFIG_UART_INTERRUPT_DRIVEN=y
CONFIG_CONSOLE=y
CONFIG_CONSOLE_HAS_DRIVER=y
CONFIG_XIP=y
```

## boards/arm/mimx8mm_evk_a53/Kconfig.board
```kconfig
#
# Copyright (c) 2019 Manivannan Sadhasivam <mani@kernel.org>
#
# SPDX-License-Identifier: Apache-2.0

config BOARD_MIMX8MM_EVK_A53
	bool "NXP i.MX8M Mini EVK (A53)"
	depends on SOC_SERIES_IMX8MM_A53
	select ARM64
```

## boards/arm/mimx8mm_evk_a53/mimx8mm_evk_a53_defconfig
```kconfig
CONFIG_ARM=y
CONFIG_SOC_FAMILY_IMX=y
CONFIG_SOC_SERIES_IMX8MM_A53=y
CONFIG_SOC_MIMX8MM6_A53=y
CONFIG_BOARD_MIMX8MM_EVK_A53=y
CONFIG_ARM_ARCH_TIMER=y
CONFIG_XIP=n

# Enable UART driver
CONFIG_SERIAL=y

# Enable console
CONFIG_CONSOLE=y
CONFIG_UART_CONSOLE=y
CONFIG_UART_INTERRUPT_DRIVEN=n

# Enable serial port
CONFIG_UART_DUMMY=y

CONFIG_SYS_CLOCK_TICKS_PER_SEC=100
```

## drivers/dma/Kconfig.mcux
```kconfig
# Kconfig.cavs - NXP MCUX DMA configuration options
#
#
# Copyright (c) 2018 Intel Corporation
#
# SPDX-License-Identifier: Apache-2.0
#

menuconfig DMA_MCUX
	bool "Enable NXP MCUX DMA driver"
	help
	  NXP MCUX DMA driver.
```

## drivers/gpio/Kconfig.acts
```kconfig
# Kconfig - GPIO driver configuration options

#
# Copyright (c) 2019 Actions (Zhuhai) Technology Co., Ltd
# 
# SPDX-License-Identifier: Apache-2.0
#

if SOC_ACTIONS_ATB110X

menuconfig GPIO_ACTS
	bool
	prompt "Actions SoC GPIO controller support"
	depends on GPIO
	default y
	help
	 Enable support for the Actions SoC clock driver.

config GPIO_ACTS_DRV_NAME
	string
	prompt "Actions SoC GPIO device name"
	depends on GPIO_ACTS
	default "gpio"

config GPIO_ACTS_INIT_PRIORITY
	int
	default 20
	prompt "Init priority"
	help
	  Device driver initialization priority.

endif # SOC_ACTIONS_GL5601A
```

## drivers/i2s/Kconfig.mcux
```kconfig
# Kconfig - NXP MCUX I2S configuration options
#
# SPDX-License-Identifier: Apache-2.0
#

menuconfig I2S_MCUX
	bool "Intel I2S (SSP) Bus Driver"
	help
	  Enable Inter Sound (I2S) bus driver for NXP MCUs.

if I2S_MCUX

config I2S_3
	bool "I2S port 3"
	help
	  Enable I2S controller port 3.

config I2S_DMA
	bool "I2S MCUX DMA"
	help
	  Use DMA for I2S transfers.

config SAI_DMA_IRQ
	int "I2S DMA IRQ"
	default 103

config SAI_DMA_IRQ_PRI
	int "I2S DMA IRQ Priority"
	default 1

endif # I2S_MCUX
```

## drivers/lora/Kconfig
```kconfig
#
# Copyright (c) 2019 Manivannan Sadhasivam
#
# SPDX-License-Identifier: Apache-2.0
#

# Top-level configuration file for LORA drivers.

menuconfig LORA
	bool "LoRa drivers"
	select HAS_SEMTECH_LORAMAC
	select HAS_SEMTECH_RADIO_DRIVERS
	help
	  Include LoRa drivers in the system configuration.

if LORA

module = LORA
module-str = lora
source "subsys/logging/Kconfig.template.log_config"

config LORA_INIT_PRIORITY
	int "LoRa initialization priority"
	default 90
	help
	  System initialization priority for LoRa drivers.

source "drivers/lora/Kconfig.sx1276"

endif # LORA
```

## drivers/lora/Kconfig.sx1276
```kconfig
#
# Copyright (c) 2019 Manivannan Sadhasivam
#
# SPDX-License-Identifier: Apache-2.0
#

menuconfig LORA_SX1276
	bool "Semtech SX1276 driver"
	select HAS_SEMTECH_SX1276
	depends on SPI
	help
	  Enable LoRa driver for Semtech SX1276.
```

## drivers/serial/Kconfig.acts
```kconfig
# Kconfig - Acts UART
#
#  * Copyright (c) 2019 Actions (Zhuhai) Technology Co., Ltd
#
# SPDX-License-Identifier: Apache-2.0
#

menuconfig UART_ACTS
	bool "acts uart driver"
	default n
	select SERIAL_HAS_DRIVER
	select SERIAL_SUPPORT_INTERRUPT
	depends on SOC_ACTIONS_ATB110X
	help
	  Enable the acts uart driver.
```

## drivers/serial/Kconfig.dummy
```kconfig
# SPDX-License-Identifier: Apache-2.0

menuconfig UART_DUMMY
	bool "MCUX uart driver"
	select SERIAL_HAS_DRIVER
	help
	  Enable the Dummy uart driver.
```

## drivers/serial/Kconfig.mcux_imx
```kconfig
# Kconfig - MCUXpresso SDK UART
#
# Copyright (c) 2017, NXP
#
# SPDX-License-Identifier: Apache-2.0
#

menuconfig UART_MCUX_IMX
	bool "MCUX IMX uart driver"
	depends on HAS_MCUX && CLOCK_CONTROL
	select SERIAL_HAS_DRIVER
	help
	  Enable the MCUX uart driver.

if UART_MCUX_IMX

menuconfig UART_MCUX_IMX_4
	bool "UART 4"
	help
	  Enable UART 4.

endif # UART_MCUX_IMX
```

## dts/bindings/dma/nxp,mcux-dma.yaml
```yaml
title: NXP MCUX DMA binding
version: 0.1

description: >
    Binding for the NXP MCUX DMA controller.

inherits:
    !include base.yaml

properties:
    compatible:
      constraint: "nxp,mcux-dma"

    reg:
      category: required

    interrupts:
      category: required
```

## dts/bindings/i2s/nxp,kinetis-i2s.yaml
```yaml
#
# SPDX-License-Identifier: Apache-2.0
#

title: Kinetis I2S Controller
version: 0.1

description: >
    This is a representation of the Kinetis I2S nodes

inherits:
    !include i2s.yaml

properties:
    compatible:
      constraint: "nxp,kinetis-i2s"

    reg:
      category: required

    interrupts:
      category: required

    clocks:
      type: array
      category: required
      description: Clock gate information
```

## dts/bindings/lora/semtech,sx1276.yaml
```yaml
#
# Copyright (c) 2019, Manivannan Sadhasivam
#
# SPDX-License-Identifier: Apache-2.0
#
---
title: Semtech SX1276 LoRa Modem

description: >
    This is a representation of the SX1276 LoRa Modem

inherits:
    !include spi-device.yaml

properties:
    compatible:
      constraint: "semtech,sx1276"

    clock-frequency:
      type: int
      category: required
      description: Input clock frequency of the LoRa device

    reset-gpios:
      type: compound
      category: optional

    dio-gpios:
      type: compound
      category: optional

...
```

## dts/bindings/serial/nxp,kinetis-uart-imx.yaml
```yaml
title: Kinetis IMX UART
version: 0.1

description: >
    This binding gives a base representation of the Kinetis IMX UART

inherits:
    !include uart.yaml

properties:
    compatible:
      constraint: "nxp,kinetis-imx-uart"

    reg:
      category: required

    interrupts:
      category: required

    clocks:
      type: array
      category: required
      description: Clock gate information
```

## dts/bindings/serial/uart,dummy.yaml
```yaml
title: Dummy UART

description: |
    This binding gives a base representation of the Dummy UART

compatible: "uart,dummy"

include: uart-controller.yaml

properties:
    reg:
      required: true
```

## modules/Kconfig.loramac-node
```kconfig
#
# Copyright (c) 2019 Manivannan Sadhasivam
#
# SPDX-License-Identifier: Apache-2.0
#

config HAS_SEMTECH_LORAMAC
	bool "LoRaMAC Support"
	select NEWLIB_LIBC
	help
	  This option enables the LoRaMAC library

config HAS_SEMTECH_RADIO_DRIVERS
	bool
	help
	  This option enables the use of Semtech's Radio drivers

if HAS_SEMTECH_RADIO_DRIVERS

config HAS_SEMTECH_SX1276
	bool
endif
```

## modules/Kconfig.rsc-table
```kconfig
#
# Copyright (c) 2019, STMICROLECTRONICS
#
# SPDX-License-Identifier: Apache-2.0
#

config RSC_TABLE
	bool "coprocessor resource table"
	imply OPENAMP
	help
	  add the resource table in the generated binary. This table is
	  compatible with linux remote proc framework and OpenAMP library.

config RSC_TABLE_SRC_PATH
	string "resource table source path"
	default "rsc_table"
	depends on RSC_TABLE
	help
	  This option specifies the path to the source for the resource table

config RSC_TABLE_NUM_RPMSG_BUFF
	int "Resource table number of rpmsg buffers"
	default 0
	depends on RSC_TABLE
	help
	  This option specifies the number of buffer used in a Vring for
	  Interprocessor communication
```
