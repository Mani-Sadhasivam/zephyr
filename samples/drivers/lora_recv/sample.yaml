## samples/drivers/lora_recv/sample.yaml
```yaml
sample:
  description: Demonstration of LoRa Receive functionality
  name: LoRa Receive Sample
tests:
  test:
    platform_whitelist: 96b_wistrio
    tags: LORA
```

## samples/drivers/lora_send/sample.yaml
```yaml
sample:
  description: Demonstration of LoRa Send functionality
  name: LoRa Send Sample
tests:
  test:
    platform_whitelist: 96b_wistrio
    tags: LORA
```

## soc/arm/nxp_imx/mimx8mm6/Kconfig.defconfig.mimx8mm6
```kconfig
# Kconfig - iMX8 M4 core series
#
# Copyright (c) 2019, Manivannan Sadhasivam <mani@kernel.org>
#
# SPDX-License-Identifier: Apache-2.0
#

if SOC_MIMX8MM6

config SOC
	string
	default "mimx8mm6"

config SYS_CLOCK_HW_CYCLES_PER_SEC
	int
	default 200000000

if CLOCK_CONTROL

config CLOCK_CONTROL_MCUX_CCM
	default y if HAS_MCUX_CCM

endif # CLOCK_CONTROL

if DMA

config DMA_MCUX
	default y

endif # DMA

if GPIO

config GPIO_MCUX_IGPIO
	default y if HAS_MCUX_IGPIO

endif # GPIO

if I2C

config I2C_MCUX
	default y

endif # I2C

if PINMUX

config PINMUX_MCUX
	default y

endif # PINMUX

if SERIAL

config UART_MCUX_IMX
	default y

endif # SERIAL

endif # SOC_MIMX8MM6
```

## soc/arm/nxp_imx/mimx8mm6/Kconfig.defconfig.series
```kconfig
# Kconfig - iMX8 M4 core series
#
# Copyright (c) 2019, Manivannan Sadhasivam <mani@kernel.org>
#
# SPDX-License-Identifier: Apache-2.0
#

if SOC_SERIES_IMX8_M4

config SOC_SERIES
	default "mimx8mm6"

config NUM_IRQS
	int
	# must be >= the highest interrupt number used
	default 127

source "soc/arm/nxp_imx/mimx8mm6/Kconfig.defconfig.mimx8mm6"

endif # SOC_SERIES_IMX8_M4
```

## soc/arm/nxp_imx/mimx8mm6/Kconfig.series
```kconfig
# Kconfig - iMX8 M4 core series
#
# Copyright (c) 2019, Manivannan Sadhasivam <mani@kernel.org>
#
# SPDX-License-Identifier: Apache-2.0
#

config SOC_SERIES_IMX8_M4
	bool "i.MX8 M4 Core Series"
	select CPU_CORTEX_M4
	select SOC_FAMILY_IMX
	select CPU_HAS_FPU
	select NOCACHE_MEMORY
	help
	  Enable support for i.MX8 M4 MCU series
```

## soc/arm/nxp_imx/mimx8mm6_a53/Kconfig.defconfig.mimx8mm6_a53
```kconfig
# Kconfig.defconfig.mimx8mm6_a53 - MIMX8MM6 A53 SoC defconfig
#
# Copyright (c) 2019, Manivannan Sadhasivam <mani@kernel.org>
#
# SPDX-License-Identifier: Apache-2.0
#

if SOC_MIMX8MM6_A53

config SOC
	default "mimx8mm6"

config SYS_CLOCK_HW_CYCLES_PER_SEC
	default 8000000 # Frequency of arch timer

if SERIAL

config UART_DUMMY # TODO: Fix it
	default y

endif # SERIAL

config FLASH_SIZE
	default $(dt_chosen_reg_size_int,$(DT_CHOSEN_Z_FLASH),0,K)

config FLASH_BASE_ADDRESS
	default $(dt_chosen_reg_addr_hex,$(DT_CHOSEN_Z_FLASH))

endif # SOC_MIMX8MM6_A53
```

## soc/arm/nxp_imx/mimx8mm6_a53/Kconfig.defconfig.series
```kconfig
# Kconfig.defconfig.series - i.MX8MM A53 SoC series defconfig
#
# Copyright (c) 2019, Manivannan Sadhasivam <mani@kernel.org>
#
# SPDX-License-Identifier: Apache-2.0
#

if SOC_SERIES_IMX8MM_A53

config SOC_SERIES
	default "mimx8mm6_a53"

config NUM_IRQS
	# must be >= the highest interrupt number used
	# - include the UART interrupts
	default 220

config 2ND_LVL_ISR_TBL_OFFSET
	default 1

config MAX_IRQ_PER_AGGREGATOR
	default 219

config NUM_2ND_LEVEL_AGGREGATORS
	default 1

source "soc/arm/nxp_imx/mimx8mm6_a53/Kconfig.defconfig.mimx8mm6_a53"

endif # SOC_SERIES_IMX8MM_A53
```

## soc/arm/nxp_imx/mimx8mm6_a53/Kconfig.series
```kconfig
# Kconfig.series - i.MX8MM A53 core series
#
# Copyright (c) 2019, Manivannan Sadhasivam <mani@kernel.org>
#
# SPDX-License-Identifier: Apache-2.0
#

config SOC_SERIES_IMX8MM_A53
	bool "i.MX8MM A53 Core Series"
	select CPU_CORTEX_A53
	select GICV3
	select SOC_FAMILY_IMX
	select MULTI_LEVEL_INTERRUPTS
	select 2ND_LEVEL_INTERRUPTS
	select BUILD_OUTPUT_HEX
	help
	  Enable support for i.MX7 M4 MCU series
```

## soc/arm/nxp_imx/mimx8mm6_a53/Kconfig.soc
```kconfig
# Kconfig - i.MX8MM A53 SoC series
#
# Copyright (c) 2019, Manivannan Sadhasivam <mani@kernel.org>
#
# SPDX-License-Identifier: Apache-2.0
#

choice
prompt "i.MX8MM A53 Selection"
depends on SOC_SERIES_IMX8MM_A53

config SOC_MIMX8MM6_A53
	bool "SOC_MIMX8MM6_A53"

endchoice
```
